## CMakeLists.txt
```
# SPDX-License-Identifier: Apache-2.0

# add needed extra modules (out of Zephyr)
list(APPEND ZEPHYR_EXTRA_MODULES
  ${CMAKE_CURRENT_SOURCE_DIR}/acousticSL
  ${CMAKE_CURRENT_SOURCE_DIR}/adv7533
  ${CMAKE_CURRENT_SOURCE_DIR}/fonts
  ${CMAKE_CURRENT_SOURCE_DIR}/otm8009a
  ${CMAKE_CURRENT_SOURCE_DIR}/stm32f769i_discovery
  ${CMAKE_CURRENT_SOURCE_DIR}/PDM
  ${CMAKE_CURRENT_SOURCE_DIR}/wm8994
  )

cmake_minimum_required(VERSION 3.20.0)

#default board
set(BOARD stm32f769i_disco)

#resolve project version
include(cmake/gitversion.cmake)
add_definitions(-DAPP_VERSION_STRING="${APP_VERSION_RAW}")
add_definitions(-DAPP_VERSION_MAJOR=${APP_VERSION_MAJOR})
add_definitions(-DAPP_VERSION_MINOR=${APP_VERSION_MINOR})
add_definitions(-DAPP_VERSION_PATCH=${APP_VERSION_PATCH})

#find and include zephyr dependencies
find_package(Zephyr REQUIRED HINTS $ENV{ZEPHYR_BASE})

#set project name
project(sound_direction_detector)

#application source files
FILE(GLOB app_sources src/*.c)
target_sources(app PRIVATE ${app_sources})
```

## Kconfig
```
# Kconfig - application configuration options

#
# Copyright (c) 2021 Bartosz Kościelniak <kostek233@gmail.com>
#
# SPDX-License-Identifier: Apache-2.0
#

mainmenu "SOUND_DIRECTION_DETECTOR"

source "Kconfig.zephyr"

config SOUND_DIRECTION_DETECTOR_STM32
	default y
	bool "Enable needed STM32 modules"
	select USE_STM32_HAL_CORTEX
	select USE_STM32_HAL_DFSDM
	select USE_STM32_HAL_DMA
	select USE_STM32_HAL_DMA2D
	select USE_STM32_HAL_DSI
	select USE_STM32_HAL_GPIO
	select USE_STM32_HAL_LTDC
	select USE_STM32_HAL_LTDC_EX
	select USE_STM32_HAL_RCC_EX
	select USE_STM32_HAL_SDRAM
	select USE_STM32_LL_FMC
```

## west.yml
```
manifest:
  defaults:
    remote: upstream

  remotes:
    - name: upstream
      url-base: https://github.com/zephyrproject-rtos

  projects:
    - name: cmsis
      revision: b0612c97c1401feeb4160add6462c3627fe90fc7
      path: modules/hal/cmsis

    - name: hal_st
      revision: 575de9d461aa6f430cf62c58a053675377e700f3
      path: modules/hal/st

    - name: hal_stm32
      revision: 5c8275071ec1cf160bfe8c18bbd9330a7d714dc8
      path: modules/hal/stm32

    - name: zephyr
      revision: 3f826560aaf81a444018293bd6acce3c339fe150 # 2.7.0
      path: zephyr
      west-commands: scripts/west-commands.yml

  self:
    path: app
```

## prj.conf
```kconfig
#enable log
CONFIG_LOG=y

#enable extra modules
CONFIG_ADV7533=y
CONFIG_FONTS=y
CONFIG_OTM8009A=y
CONFIG_STM32F769I_DISCOVERY=y


CONFIG_I2S=y
```

## boards/stm32f769i_disco.overlay
```dts
/*
 * Copyright (c) 2021 Bartosz Kościelniak <kostek233@gmail.com>
 *
 * SPDX-License-Identifier: Apache-2.0
 */

&dma2 {
        status = "okay";
};
```

## src/main.c
```c
/*
 * Copyright (c) 2021 Bartosz Kościelniak <kostek233@gmail.com>
 *
 * SPDX-License-Identifier: Apache-2.0
 */

#include <logging/log.h>
LOG_MODULE_REGISTER(main);

#include "main.h"
#include "stm32f7xx_hal.h"
#include "stm32f769i_discovery.h"
#include "stm32f769i_discovery_audio.h"
#include "stm32f769i_discovery_lcd.h"

#include "audio_application.h"

#define SCRATCH_BUFF_SIZE  512

extern uint16_t PCM_Buffer[AUDIO_IN_CHANNELS*AUDIO_IN_SAMPLING_FREQUENCY/1000];
int32_t Scratch[SCRATCH_BUFF_SIZE];

void main(void)
{
	int ret;
	uint8_t lcd_status = LCD_OK;

	/* Initialize the LCD */
        lcd_status = BSP_LCD_Init();
        while(lcd_status != LCD_OK);

        BSP_LCD_LayerDefaultInit(0, LCD_FB_START_ADDRESS);
        BSP_LCD_Clear(LCD_COLOR_WHITE);

	LOG_INF("Welcome to Sound Direction Detector, version: %u.%u.%u (%s)",
		APP_VERSION_MAJOR, APP_VERSION_MINOR, APP_VERSION_PATCH,
		APP_VERSION_STRING);

	BSP_AUDIO_IN_Init(AUDIO_IN_SAMPLING_FREQUENCY, 16, AUDIO_IN_CHANNELS);
	BSP_AUDIO_IN_AllocScratch(Scratch, SCRATCH_BUFF_SIZE);

        /* Initialize Acoustic_SL library */
        Audio_Libraries_Init();

        /* Initialize software interrupt tasks */
        SW_IRQ_Tasks_Init();

        /* Start audio acquisition */
	ret = BSP_AUDIO_IN_Record(PCM_Buffer, AUDIO_IN_BUFFER_SIZE);
        if (ret != AUDIO_OK) {
		LOG_ERR("Start audio acquisition error %d", ret);
		Error_Handler();
  	}

	LOG_INF("Recording started!");
}
```

## include/stm32f769i_discovery_errno.h
```c
/**
  ******************************************************************************
  * @file    stm32f769i_discovery_errno.h
  * @author  SRA
  * @version v1.3.0
  * @date    17-Sep-2021
  * @brief   Error Code
  ******************************************************************************
  * @attention
  *
  * <h2><center>&copy; Copyright (c) 2020 STMicroelectronics.
  * All rights reserved.</center></h2>
  *
  * This software component is licensed by ST under Ultimate Liberty license
  * SLA0055, the "License"; You may not use this file except in compliance with
  * the License. You may obtain a copy of the License at:
  *                             www.st.com/SLA0055
  *
  ******************************************************************************
*/

/* Define to prevent recursive inclusion -------------------------------------*/
#ifndef __STM32F769I_DISCOVERY_ERRNO_H
#define __STM32F769I_DISCOVERY_ERRNO_H

#ifdef __cplusplus
extern "C" {
#endif

/* Common Error codes */
#define BSP_ERROR_NONE                    0
#define BSP_ERROR_NO_INIT                -1
#define BSP_ERROR_WRONG_PARAM            -2
#define BSP_ERROR_BUSY                   -3
#define BSP_ERROR_PERIPH_FAILURE         -4
#define BSP_ERROR_COMPONENT_FAILURE      -5
#define BSP_ERROR_UNKNOWN_FAILURE        -6
#define BSP_ERROR_UNKNOWN_COMPONENT      -7
#define BSP_ERROR_BUS_FAILURE            -8
#define BSP_ERROR_CLOCK_FAILURE          -9
#define BSP_ERROR_MSP_FAILURE            -10

#ifdef __cplusplus
}
#endif

#endif /* __STM32F769I_DISCOVERY_ERRNO_H */

/************************ (C) COPYRIGHT STMicroelectronics *****END OF FILE****/
```

## src/audio_application.c
```c
/**
  ******************************************************************************
  * @file    audio_application.c
  * @author  SRA
  * @version v1.3.0
  * @date    17-Sep-2021
  * @brief   Source localization example.
  ******************************************************************************
  * @attention
  *
  * <h2><center>&copy; Copyright (c) 2020 STMicroelectronics.
  * All rights reserved.</center></h2>
  *
  * This software component is licensed by ST under Ultimate Liberty license
  * SLA0055, the "License"; You may not use this file except in compliance with
  * the License. You may obtain a copy of the License at:
  *                             www.st.com/SLA0055
  *
  ******************************************************************************
  */

/* Includes ------------------------------------------------------------------*/
#include <stdlib.h>
#include <stdio.h>

#include "audio_application.h"
#include "acoustic_sl.h"

uint16_t PCM_Buffer[AUDIO_IN_CHANNELS*AUDIO_IN_SAMPLING_FREQUENCY/1000];
AcousticSL_Handler_t libSoundSourceLoc_Handler_Instance;
AcousticSL_Config_t  libSoundSourceLoc_Config_Instance;
volatile int16_t  SOURCE_Angle_Value = 0;
volatile uint16_t SOURCE_Enable_Value = 1;
volatile int32_t result[2];

void BSP_AUDIO_IN_HalfTransfer_CallBack()
{
  AudioProcess();
}

void BSP_AUDIO_IN_TransferComplete_CallBack()
{
  AudioProcess();
}

/**
* @brief  User function that is called when 1 ms of PDM data is available.
* 		  In this application only PDM to PCM conversion and USB streaming
*                  is performed.
* 		  User can add his own code here to perform some DSP or audio analysis.
*                In this case audio libraries are used
* @param  none
* @retval None
*/
void AudioProcess(void)
{
  if(AcousticSL_Data_Input((int16_t *)&PCM_Buffer[BOTTOM_LEFT_MIC],
                           (int16_t *)&PCM_Buffer[TOP_RIGHT_MIC],
                           (int16_t *)&PCM_Buffer[BOTTOM_RIGHT_MIC],
                           (int16_t *)&PCM_Buffer[TOP_LEFT_MIC],
                           &libSoundSourceLoc_Handler_Instance) == 1U)
  {
    SW_Task2_Start(); /*Localization Processing Task*/
  }
}

/**
* @brief  Initialize the audio libraries adopted
* @param  None
* @retval None
*/
void Audio_Libraries_Init(void)
{
  volatile uint32_t error_value = 0;
  /* Enable CRC peripheral to unlock the library */
  __CRC_CLK_ENABLE();

  /*Setup Source Localization static parameters*/
  libSoundSourceLoc_Handler_Instance.channel_number = 4;
  libSoundSourceLoc_Handler_Instance.M12_distance =DIAGONAL;
  libSoundSourceLoc_Handler_Instance.M34_distance =DIAGONAL;
  libSoundSourceLoc_Handler_Instance.sampling_frequency = AUDIO_IN_SAMPLING_FREQUENCY;
  libSoundSourceLoc_Handler_Instance.algorithm = ACOUSTIC_SL_ALGORITHM_GCCP;
  libSoundSourceLoc_Handler_Instance.ptr_M1_channels = 4;
  libSoundSourceLoc_Handler_Instance.ptr_M2_channels = 4;
  libSoundSourceLoc_Handler_Instance.ptr_M3_channels = 4;
  libSoundSourceLoc_Handler_Instance.ptr_M4_channels = 4;
  libSoundSourceLoc_Handler_Instance.samples_to_process = 512;
  (void)AcousticSL_getMemorySize( &libSoundSourceLoc_Handler_Instance);
  libSoundSourceLoc_Handler_Instance.pInternalMemory=(uint32_t *)malloc(libSoundSourceLoc_Handler_Instance.internal_memory_size);
  error_value += AcousticSL_Init( &libSoundSourceLoc_Handler_Instance);

  /*Setup Source Localization dynamic parameters*/
  libSoundSourceLoc_Config_Instance.resolution=10;
  libSoundSourceLoc_Config_Instance.threshold=24;
  error_value += AcousticSL_setConfig(&libSoundSourceLoc_Handler_Instance, &libSoundSourceLoc_Config_Instance);

  /*Error Management*/
  if(error_value != 0U)
  {
    Error_Handler();
  }

  /*Malloc Failure*/
  if(libSoundSourceLoc_Handler_Instance.pInternalMemory == NULL)
  {
    Error_Handler();
  }

}

/**
* @brief  Initializes two SW interrupt with different priorities
* @param  None
* @retval None
*/
void SW_IRQ_Tasks_Init(void)
{
  HAL_NVIC_SetPriority((IRQn_Type)EXTI1_IRQn, 0x0D, 0);
  HAL_NVIC_EnableIRQ((IRQn_Type)EXTI1_IRQn);

  HAL_NVIC_SetPriority((IRQn_Type)EXTI2_IRQn, 0x0E, 0);
  HAL_NVIC_EnableIRQ((IRQn_Type)EXTI2_IRQn);

}


/**
* @brief  Highest priority interrupt handler routine
* @param  None
* @retval None
*/
void SW_Task1_Callback(void)
{

}

/**
* @brief Lower priority interrupt handler routine
* @param  None
* @retval None
*/

void SW_Task2_Callback(void)
{
  (void)AcousticSL_Process((int32_t *)&result, &libSoundSourceLoc_Handler_Instance);

  if(result[0]==ACOUSTIC_SL_NO_AUDIO_DETECTED)
  {
    result[0] = -1;
  }

  if(result[0] != -1)
  {
    //char output[4];
    //int32_t n = sprintf(output,"%i",(int32_t)result[0]);
    //(void)HAL_UART_Transmit(&UartHandle, (uint8_t *)"    ", 4, 0xFFFF);
    //(void)HAL_UART_Transmit(&UartHandle, (uint8_t *)"\r", 1, 0xFFFF);
    //(void)HAL_UART_Transmit(&UartHandle, (uint8_t *)output, (uint16_t)n, 0xFFFF);
  }
}


/**
* @brief Throws Highest priority interrupt
* @param  None
* @retval None
*/
void SW_Task1_Start(void)
{
  HAL_NVIC_SetPendingIRQ(EXTI1_IRQn);
}

void SW_Task2_Start(void)
{
  HAL_NVIC_SetPendingIRQ(EXTI2_IRQn);
}


void Error_Handler(void)
{
  while(1);
}


/**
* @}
*/

/**
* @}
*/

/**
* @}
*/

/**
* @}
*/
/************************ (C) COPYRIGHT STMicroelectronics *****END OF FILE****/
```

## src/audio_application.h
```c
/**
  ******************************************************************************
  * @file    audio_application.h
  * @author  SRA
  * @version v1.3.0
  * @date    17-Sep-2021
  * @brief   Header for audio_application.c module.
  ******************************************************************************
  * @attention
  *
  * <h2><center>&copy; Copyright (c) 2020 STMicroelectronics.
  * All rights reserved.</center></h2>
  *
  * This software component is licensed by ST under Ultimate Liberty license
  * SLA0055, the "License"; You may not use this file except in compliance with
  * the License. You may obtain a copy of the License at:
  *                             www.st.com/SLA0055
  *
  ******************************************************************************
  */

/* Define to prevent recursive inclusion -------------------------------------*/
#ifndef __AUDIO_APPLICATION_H
#define __AUDIO_APPLICATION_H

/* Includes ------------------------------------------------------------------*/
#include "stm32f7xx_hal.h"
#include "stm32xx_it.h"
#include "stm32f769i_discovery.h"
//#include "stm32f769i_discovery_audio_ex.h"

/** @addtogroup X_CUBE_MEMSMIC1_Applications
  * @{
  */

/** @addtogroup ACOUSTIC_SL_Example
  * @{
  */

/** @defgroup AUDIO_APPLICATION
  * @{
  */

 /** @defgroup AUDIO_APPLICATION_Private_Types
  * @{
  */

  /**
  * @}
  */

/* The N_MS value defines the number of millisecond to be processed at each AudioProcess call,
that must be consistent with the N_MS_PER_INTERRUPT defined in the audio driver
(stm32f769i_discovery_audio_ex.h).
The default value of the N_MS_PER_INTERRUPT directive in the driver is set to 1,
for backward compatibility: leaving this values as it is allows to avoid any
modification in the application layer developed with the older versions of the driver */


#define N_MS (N_MS_PER_INTERRUPT)

#define AUDIO_IN_CHANNELS 4
#define AUDIO_IN_SAMPLING_FREQUENCY 16000

#define AUDIO_IN_BUFFER_SIZE            (AUDIO_IN_CHANNELS*AUDIO_IN_SAMPLING_FREQUENCY/1000)
#define AUDIO_VOLUME_INPUT              64U
#define STM32F769I_DISCOVERY_AUDIO_INSTANCE             1U /*Select 0U or 1U in base of the peripheral used (0U->I2S/SAI 1U->DFSDM)*/
#define STM32F769I_DISCOVERY_AUDIO_IN_IT_PRIORITY       5U

#if (AUDIO_IN_SAMPLING_FREQUENCY == 8000)
#define MAX_DECIMATION_FACTOR 160
#else
#define MAX_DECIMATION_FACTOR 128
#endif


/* 	If you want to customize the length of the buffers used into the BSP, uncomment and modify these defines.
	Change the values according to the max PDM clock you want to customize and number of microphones you want to use
*/

//	#define MAX_MIC_FREQ                 	  3072  /*kHz - Maximum PDM clock */
//	#define MAX_AUDIO_IN_CHANNEL_NBR_PER_IF   2 /* Maximum number of microhpones channels for peripheral interface */
//	#define MAX_AUDIO_IN_CHANNEL_NBR_TOTAL    4 /* For WB, this must be minimum equal to 2 */


//  #define USE_SPI3
/*If you want to use SPI3 instead of SPI2 for M3 and M4, uncomment this define and
close SB20 and SB21*/

//  #define PDM_FREQ_16K 2048
/*Uncomment if you need to change PDM clock frequency when AUDIO_IN_SAMPLING_FREQUENCY = 16000*/

/* Exported constants --------------------------------------------------------*/
/* Exported macro ------------------------------------------------------------*/
/** @defgroup AUDIO_APPLICATION_Exported_Defines
 * @{
 */

#define TOP_LEFT_MIC 3
#define TOP_RIGHT_MIC 0
#define BOTTOM_LEFT_MIC 2
#define BOTTOM_RIGHT_MIC 1
#define SIDE 147
#define DIAGONAL 212

/**
 * @}
 */
/* Exported functions ------------------------------------------------------- */
void Audio_Libraries_Init(void);
void Error_Handler(void);
void AudioProcess(void);
void SW_IRQ_Tasks_Init(void);
void SW_Task1_Callback(void);
void SW_Task2_Callback(void);
void SW_Task1_Start(void);
void SW_Task2_Start(void);


/**
 * @}
 */

/**
 * @}
 */

/**
 * @}
 */



#endif /* __AUDIO_APPLICATION_H */

/************************ (C) COPYRIGHT STMicroelectronics *****END OF FILE****/
```

## src/main.h
```c
/**
  ******************************************************************************
  * @file    main.h
  * @brief   Header for main.c module
  ******************************************************************************
  * @attention
  *
  * <h2><center>&copy; Copyright (c) 2016 STMicroelectronics.
  * All rights reserved.</center></h2>
  *
  * This software component is licensed by ST under BSD 3-Clause license,
  * the "License"; You may not use this file except in compliance with the
  * License. You may obtain a copy of the License at:
  *                        opensource.org/licenses/BSD-3-Clause
  *
  ******************************************************************************
  */

/* Define to prevent recursive inclusion -------------------------------------*/
#ifndef __MAIN_H
#define __MAIN_H

/* Includes ------------------------------------------------------------------*/
#include <stdio.h>
#include <string.h>
#include "stm32f7xx_hal.h"
#include "stm32f769i_discovery.h"
#include "stm32f769i_discovery_lcd.h"

/* Exported types ------------------------------------------------------------*/
typedef struct
{
  void   (*DemoFunc)(void);
  uint8_t DemoName[50];
  uint32_t DemoIndex;
}BSP_DemoTypedef;

typedef enum {
  AUDIO_ERROR_NONE = 0,
  AUDIO_ERROR_NOTREADY,
  AUDIO_ERROR_IO,
  AUDIO_ERROR_EOF,
}AUDIO_ErrorTypeDef;

/* Exported variables --------------------------------------------------------*/
extern const unsigned char stlogo[];
extern __IO uint32_t SdmmcTest;
extern __IO uint32_t SdramTest;
/* Exported constants --------------------------------------------------------*/

/* LCD Frame buffer start address : starts at beginning of SDRAM */
#define ARBG8888_BYTE_PER_PIXEL   4
#define LCD_FB_LENGTH              ((uint32_t)(OTM8009A_480X800_HEIGHT * OTM8009A_480X800_WIDTH * ARBG8888_BYTE_PER_PIXEL))
#define SDRAM_WRITE_READ_ADDR        ((uint32_t)0xC0177000)

/* Exported macro ------------------------------------------------------------*/
#define COUNT_OF_EXAMPLE(x)    (sizeof(x)/sizeof(BSP_DemoTypedef))

#ifdef USE_FULL_ASSERT
/* Assert activated */
#define BSP_TEST_APPLI_ASSERT(__error_condition__)    do { if(__error_condition__) \
                                                           {  while(1);  \
                                                           } \
                                                          } while(0)
#else
/* Assert not activated : macro has no effect */
#define BSP_TEST_APPLI_ASSERT(__error_condition__)    do { if(__error_condition__) \
                                                           {  ;  \
                                                           } \
                                                         } while(0)
#endif /* USE_FULL_ASSERT */

/* Exported functions ------------------------------------------------------- */
void AudioLoopback_demo(void);

#endif /* __MAIN_H */

/************************ (C) COPYRIGHT STMicroelectronics *****END OF FILE****/
```

## src/stm32xx_it.c
```c
/**
  ******************************************************************************
  * @file    stm32xx_it.c
  * @author  SRA
  * @version v1.3.0
  * @date    17-Sep-2021
  * @brief   Main Interrupt Service Routines.
  *          This file provides exceptions handler and
  *          peripherals interrupt service routine.
  ******************************************************************************
  * @attention
  *
  * <h2><center>&copy; Copyright (c) 2020 STMicroelectronics.
  * All rights reserved.</center></h2>
  *
  * This software component is licensed by ST under Ultimate Liberty license
  * SLA0055, the "License"; You may not use this file except in compliance with
  * the License. You may obtain a copy of the License at:
  *                             www.st.com/SLA0055
  *
  ******************************************************************************
  */

/* Includes ------------------------------------------------------------------*/
#include "stm32xx_it.h"
#include "audio_application.h"

/* Private typedef -----------------------------------------------------------*/
/* Private define ------------------------------------------------------------*/
/* Private macro -------------------------------------------------------------*/
/* Private variables ---------------------------------------------------------*/
extern PCD_HandleTypeDef hpcd;
/* Private function prototypes -----------------------------------------------*/
/* Private functions ---------------------------------------------------------*/

/** @addtogroup X_CUBE_MEMSMIC1_Applications
* @{
*/

/** @addtogroup ACOUSTIC_SL_Example
* @{
*/

/** @defgroup INTERRUPT_HANDLER
* @{
*/
/******************************************************************************/
/*             Cortex-M0+ Processor Exceptions Handlers                         */
/******************************************************************************/

/**
  * @brief  This function handles NMI exception.
  * @param  None
  * @retval None
  */
void NMI_Handler(void)
{
}

/**
  * @brief  This function handles Hard Fault exception.
  * @param  None
  * @retval None
  */
void HardFault_Handler(void)
{
  /* Go to infinite loop when Hard Fault exception occurs */
  while (1)
  {
  }
}

/**
  * @brief  This function handles SVCall exception.
  * @param  None
  * @retval None
  */
void SVC_Handler(void)
{
}

/**
  * @brief  This function handles Debug Monitor exception.
  * @param  None
  * @retval None
  */
void DebugMon_Handler(void)
{
}

/**
  * @brief  This function handles PendSVC exception.
  * @param  None
  * @retval None
  */
void PendSV_Handler(void)
{
}

/**
  * @brief  This function handles SysTick Handler.
  * @param  None
  * @retval None
  */
void SysTick_Handler(void)
{
  HAL_IncTick();
}

/**
  * @brief  This function handles USB Handler.
  * @param  None
  * @retval None
  */
void USB_IRQHandler(void)
{
  HAL_PCD_IRQHandler(&hpcd);
}

/**
  * @brief  This function handles DMA Stream interrupt request.
  * @param  None
  * @retval None
  */
void AUDIO_IN_I2S_IRQHandler(void)
{
  HAL_DMA_IRQHandler(hAudioInI2s.hdmarx);
}

/**
* @brief  This function handles EXTI1 interrupt.
* @param  None
* @retval None
*/
void EXTI1_IRQHandler(void)
{
   HAL_GPIO_EXTI_IRQHandler(GPIO_PIN_1);
   SW_Task1_Callback();
}

/**
* @brief  This function handles EXTI2 interrupt.
* @param  None
* @retval None
*/
void EXTI2_IRQHandler(void)
{
   HAL_GPIO_EXTI_IRQHandler(GPIO_PIN_2);
   SW_Task2_Callback();
}

/**
* @}
*/

/**
* @}
*/

/**
* @}
*/

/************************ (C) COPYRIGHT STMicroelectronics *****END OF FILE****/
```

## src/stm32xx_it.h
```c
/**
  ******************************************************************************
  * @file    stm32xx_it.h
  * @author  SRA
  * @version v1.3.0
  * @date    17-Sep-2021
  * @brief   This file contains the headers of the interrupt handlers.
  ******************************************************************************
  * @attention
  *
  * <h2><center>&copy; Copyright (c) 2020 STMicroelectronics.
  * All rights reserved.</center></h2>
  *
  * This software component is licensed by ST under Ultimate Liberty license
  * SLA0055, the "License"; You may not use this file except in compliance with
  * the License. You may obtain a copy of the License at:
  *                             www.st.com/SLA0055
  *
  ******************************************************************************
  */

/* Define to prevent recursive inclusion -------------------------------------*/
#ifndef __STM32xx_IT_H
#define __STM32xx_IT_H

#ifdef __cplusplus
 extern "C" {
#endif

/* Includes ------------------------------------------------------------------*/
#include "stm32f7xx_hal.h"
#include "stm32f769i_discovery.h"

/* Exported types ------------------------------------------------------------*/
/* Exported constants --------------------------------------------------------*/
/* Exported macro ------------------------------------------------------------*/
/* Exported functions ------------------------------------------------------- */

extern I2S_HandleTypeDef                hAudioInI2s;

void NMI_Handler(void);
void HardFault_Handler(void);
void SVC_Handler(void);
void DebugMon_Handler(void);
void PendSV_Handler(void);
void SysTick_Handler(void);
void USB_IRQHandler(void);
void AUDIO_IN_I2S_IRQHandler(void);
void BSP_USART_DMA_STREAM_TX_IRQHandler(void);
void USARTx_IRQHandler(void);
void EXTI1_IRQHandler(void);
void EXTI2_IRQHandler(void);



#ifdef __cplusplus
}
#endif

#endif /* __STM32xx_IT_H */

/************************ (C) COPYRIGHT STMicroelectronics *****END OF FILE****/
```
