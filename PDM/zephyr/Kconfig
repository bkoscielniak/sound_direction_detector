## PDM/zephyr/Kconfig
```kconfig
# SPDX-License-Identifier: Apache-2.0

config STM32_PDM
	bool "Enable support for the STM32 PDM Filter"
```

## acousticSL/zephyr/Kconfig
```kconfig
# SPDX-License-Identifier: Apache-2.0

config ACOUSTIC_SL
	bool "Enable support for the STM32 Acoustic SL"
```

## adv7533/zephyr/Kconfig
```kconfig
# SPDX-License-Identifier: Apache-2.0

config ADV7533
	bool "Enable support for the ADV7533"
```

## fonts/zephyr/Kconfig
```kconfig
# SPDX-License-Identifier: Apache-2.0

config FONTS
	bool "Enable support for the Fonts"
```

## otm8009a/zephyr/Kconfig
```kconfig
# SPDX-License-Identifier: Apache-2.0

config OTM8009A
	bool "Enable support for the OTM8009A"
```

## stm32f769i_discovery/zephyr/Kconfig
```kconfig
# SPDX-License-Identifier: Apache-2.0

config STM32F769I_DISCOVERY
	bool "Enable support for the STM32F769I Discovery peripherals"
```

## wm8994/zephyr/Kconfig
```kconfig
# SPDX-License-Identifier: Apache-2.0

config WM8994
	bool "Enable support for the WM8994"
```
